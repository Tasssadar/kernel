## drivers/staging/zram/Kconfig
```kconfig
config XVMALLOC
	bool
	default n

config ZRAM
	tristate "Compressed RAM block device support"
	select LZO_COMPRESS
	select LZO_DECOMPRESS
	select XVMALLOC
	default n
	help
	  Creates virtual block devices called /dev/zramX (X = 0, 1, ...).
	  Pages written to these disks are compressed and stored in memory
	  itself. These disks allow very fast I/O and compression provides
	  good amounts of memory savings.

	  It has several use cases, for example: /tmp storage, use as swap
	  disks and maybe many more.

	  See zram.txt for more information.
	  Project home: http://compcache.googlecode.com/

config ZRAM_STATS
	bool "Enable statistics for compressed RAM disks"
	depends on ZRAM
	default y
	help
	  Enable statistics collection for compressed RAM devices. Statistics
	  are exported through ioctl interface, so you have to use zramconfig
	  program to get them. This adds only a minimal overhead.

	  If unsure, say Y.

config ZCACHE
	bool "Page cache compression support"
	depends on CLEANCACHE
	select XVMALLOC
	select LZO_COMPRESS
	select LZO_DECOMPRESS
	default n
	help
	  Compresses relatively unused page cache pages and stores them in
	  memory itself. This increases effective memory size and can help
	  reduce access to backing store device(s) which is typically much
	  slower than access to main memory.

	  Statistics are expoted through sysfs interface:
	  /sys/kernel/mm/zcache/

	  Project home: http://compcache.googlecode.com/
```
